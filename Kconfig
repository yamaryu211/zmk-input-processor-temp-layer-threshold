## Kconfig
```kconfig
config ZMK_INPUT_PROCESSOR_TEMP_LAYER_THRESHOLD
    bool "Enable threshold-based temporary layer input processor"
    default y
    depends on ZMK_POINTING
    depends on (!ZMK_SPLIT || ZMK_SPLIT_ROLE_CENTRAL)

if ZMK_INPUT_PROCESSOR_TEMP_LAYER_THRESHOLD

config ZMK_INPUT_PROCESSOR_TEMP_LAYER_THRESHOLD_MAX_ACTION_EVENTS
    int "Maximum number of layer action events"
    default 16

endif
```

## dts/bindings/zmk,input-processor-temp-layer-threshold.yaml
```yaml
# Copyright (c) 2024 The ZMK Contributors
# SPDX-License-Identifier: MIT

description: |
  Temporary layer input processor with movement threshold.
  Activates a layer only after cumulative movement exceeds a threshold.

compatible: "zmk,input-processor-temp-layer-threshold"

properties:
  "#input-processor-cells":
    type: int
    required: true
    const: 2

  track-remainders:
    type: boolean

  threshold:
    type: int
    default: 0
    description: |
      Movement threshold before layer activation. Set to 0 for immediate activation.

  require-prior-idle-ms:
    type: int
    default: 0
    description: |
      Milliseconds of no key presses before activation is allowed

  excluded-positions:
    type: array
    default: []
    description: |
      Key positions that won't deactivate the layer when pressed
      while the layer is active

  reset-timeout-ms:
    type: int
    default: 200
    description: |
      Milliseconds without movement before resetting accumulated movement

input-processor-cells:
  - param1
  - param2
```
